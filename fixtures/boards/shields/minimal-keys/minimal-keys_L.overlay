#include "minimal-keys.dtsi"

&xiao_serial { status = "disabled"; };

&kscan0 {
        col-gpios
            = <&xiao_d 7 GPIO_ACTIVE_HIGH>
            , <&xiao_d 3 GPIO_ACTIVE_HIGH> 
            , <&xiao_d 5 GPIO_ACTIVE_HIGH> 
            , <&xiao_d 4 GPIO_ACTIVE_HIGH> 
            , <&xiao_d 6 GPIO_ACTIVE_HIGH>
            , <&gpio0 9 GPIO_ACTIVE_HIGH>
            ;
    row-gpios
        =<&xiao_d 2  (GPIO_ACTIVE_HIGH | GPIO_PULL_DOWN)>,  /* 行ピンは全てプルダウン */
                <&xiao_d 10 (GPIO_ACTIVE_HIGH | GPIO_PULL_DOWN)>,
                <&xiao_d 9  (GPIO_ACTIVE_HIGH | GPIO_PULL_DOWN)>,
                <&xiao_d 8  (GPIO_ACTIVE_HIGH | GPIO_PULL_DOWN)>;
};

&left_encoder {
    status = "okay";
    a-gpios = <&xiao_d 1 (GPIO_ACTIVE_HIGH | GPIO_PULL_UP)>;
    b-gpios = <&xiao_d 0 (GPIO_ACTIVE_HIGH | GPIO_PULL_UP)>;
};